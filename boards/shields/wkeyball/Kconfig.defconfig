## boards/shields/wkeyball/Kconfig.defconfig
```kconfig
if SHIELD_WKEYBALL_LEFT

config ZMK_KEYBOARD_NAME
    default "wkeyball"

config ZMK_SPLIT_ROLE_CENTRAL
    default y

endif # SHIELD_WKEYBALL_LEFT

if SHIELD_WKEYBALL_LEFT || SHIELD_WKEYBALL_RIGHT

config ZMK_SPLIT
    default y

endif # SHIELD_WKEYBALL_LEFT || SHIELD_WKEYBALL_RIGHT
```

## boards/shields/wkeyball/Kconfig.shield
```kconfig
config SHIELD_WKEYBALL_LEFT
    def_bool $(shields_list_contains,wkeyball_left)

config SHIELD_WKEYBALL_RIGHT
    def_bool $(shields_list_contains,wkeyball_right)
```
